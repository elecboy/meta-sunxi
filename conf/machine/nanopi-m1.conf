## conf/machine/nanopi-m1.conf
```bitbake
#@TYPE: Machine
#@NAME: nanopi-m1
#@DESCRIPTION: Machine configuration for the FriendlyARM NanoPi Neo, based on the Allwinner H3 CPU

require conf/machine/include/sun8i.inc

PREFERRED_VERSION_linux = "4.12.%"
PREFERRED_VERSION_u-boot = "v2017.03%"

KERNEL_DEVICETREE = "sun8i-h3-orangepi-pc.dts"
UBOOT_MACHINE = "orangepi_pc_defconfig"

DEFAULTTUNE = "cortexa7hf-neon-vfpv4"
```

## conf/machine/nanopi-neo.conf
```bitbake
#@TYPE: Machine
#@NAME: nanopi-neo
#@DESCRIPTION: Machine configuration for the FriendlyARM NanoPi Neo, based on the Allwinner H3 CPU

require conf/machine/include/sun8i.inc

PREFERRED_VERSION_linux = "4.13.%"
PREFERRED_VERSION_u-boot = "v2017.07%"

KERNEL_DEVICETREE = "sun8i-h3-nanopi-neo.dtb sun8i-h3-nanopi-neo-air.dtb"
UBOOT_MACHINE = "nanopi_neo_air_defconfig"

DEFAULTTUNE = "cortexa7hf-neon-vfpv4"
MACHINE_EXTRA_RRECOMMENDS += "u-boot-fw-utils u-boot-mkimage"
MACHINE_EXTRA_RRECOMMENDS += "linux-firmware-bcm43430 rfkill nanopi-neo-air-fix"
```
